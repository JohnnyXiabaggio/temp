AUTOSAR XML (schema 4.0)
package /TGW_PduR_Cfg
  module config PduR
    3 x :
      PduRGeneral: PduRDevErrorDetect=false, PduRZeroCostOperation=false, PduRMetaDataSupport=true
      RP_EngineTrq_Cmd: PduRSrcModule=CAN_IF, PduRSrcPduHandleId=0x11, AsilLevel=ASIL_D, LatencyBudgetUs=1000, E2EProfile=PROFILE_02, SecOC=ENABLED
        DestPdu_CN1 (): PduRDestModule=CAN_IF, PduRDestPduHandleId=0x111
      RP_Telematics_Cmd_Gated: PduRSrcModule=SO_AD, PduRSrcPduHandleId=0xA0, AsilLevel=ASIL_B, IngressGate=SECOC_AND_RATELIMIT_AND_ALLOWLIST
